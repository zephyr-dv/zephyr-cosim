## share/board/Kconfig.board
```kconfig
# SPDX-License-Identifier: Apache-2.0

config BOARD_{{name|upper}}_32BIT
	bool "Native POSIX for 32-bit host"
	depends on SOC_COSIM
	select BOARD_{{name|upper}}
	help
	  Will produce a console Linux process which can be executed natively
	  as a 32-bit executable.
	  It provides some minimal needed models:
	  An interrupt controller, timer (system tick), and redirects kernel prints to
	  stdout.

config BOARD_{{name|upper}}_64BIT
	bool "Native POSIX for 64-bit host"
	depends on SOC_COSIM
	select BOARD_{{name|upper}}
	select 64BIT
	help
	  Will produce a console Linux process which can be executed natively
	  as a 64-bit executable.
	  It provides some minimal needed models:
	  An interrupt controller, timer (system tick), and redirects kernel prints to
	  stdout.
```

## share/board/board_64_defconfig
```kconfig
# SPDX-License-Identifier: Apache-2.0
{% set filename = "{{name}}_64_defconfig" %}

CONFIG_SOC_COSIM=y
CONFIG_BOARD_{{name|upper}}_64BIT=y
CONFIG_CONSOLE=y
CONFIG_SYS_CLOCK_HW_CYCLES_PER_SEC=1000000
```

## share/board/board_defconfig
```kconfig
# SPDX-License-Identifier: Apache-2.0
{% set filename = "{{name}}_defconfig" %}

CONFIG_SOC_COSIM=y
CONFIG_BOARD_{{name|upper}}_32BIT=y
CONFIG_CONSOLE=y
CONFIG_SYS_CLOCK_HW_CYCLES_PER_SEC=1000000
```

## share/zephyr/dts/bindings/zephyr-cosim-intc.yaml
```yaml
description: LiteX VexRiscV interrupt controller

compatible: "zephyr-cosim-intc"

include: [interrupt-controller.yaml, base.yaml]

properties:
#  riscv,max-priority:
#      type: int
#      description: maximum interrupt priority
#      required: true

  "#interrupt-cells":
      const: 2

interrupt-cells:
  - irq
  - priority

  
```

## share/zephyr/soc/posix/cosim/Kconfig.defconfig
```kconfig
# Copyright (c) 2017 Intel Corporation
# Copyright (c) 2021 Matthew Ballance
# SPDX-License-Identifier: Apache-2.0

config SOC
	default "cosim"
	depends on SOC_COSIM
```

## share/zephyr/soc/posix/cosim/Kconfig.soc
```kconfig
# SPDX-License-Identifier: Apache-2.0

config SOC_COSIM
	bool "Native POSIX port"
	select ARCH_POSIX
	select CPLUSPLUS
	select LIB_CPLUSPLUS
	help
	  SOC for to the POSIX arch that enables co-simulation with an HDL simulation
	  environment.
```
